## drivers/net/wireless/bcmdhd_1_141_66/Kconfig
```kconfig
config BCMDHD_1_141_66
	tristate "Broadcom bcm43438 wireless cards support"
	---help---
	  This module adds support for wireless adapters based on
	  Broadcom bcm43438 chipset.

config BCMDHD_FW_PATH
	depends on BCMDHD_1_141_66
	string "Firmware path"
	default "/lib/firmware/fw_bcm43438.bin"
	---help---
	  Path to the firmware file.

config BCMDHD_NVRAM_PATH
	depends on BCMDHD_1_141_66
	string "NVRAM path"
	default "/lib/firmware/bcm43438.cal"
	---help---
	  Path to the calibration file.

config BCMDHD_WEXT
	bool "Enable WEXT support"
	depends on BCMDHD_1_141_66 && CFG80211 = n
	select WIRELESS_EXT
	select WEXT_PRIV
	help
	  Enables WEXT support

choice
	prompt "Enable Chip Interface"
	depends on BCMDHD_1_141_66
	---help---
		Enable Chip Interface.
config BCMDHD_SDIO
		bool "SDIO bus interface support"
		depends on BCMDHD_1_141_66 && MMC
config BCMDHD_PCIE
		bool "PCIe bus interface support"
		depends on BCMDHD_1_141_66 && PCI
endchoice

choice
	depends on BCMDHD_1_141_66 && BCMDHD_SDIO
	prompt "Interrupt type"
	---help---
		Interrupt type
config BCMDHD_OOB
	depends on BCMDHD_1_141_66 && BCMDHD_SDIO
	bool "Out-of-Band Interrupt"
	---help---
		Interrupt from WL_HOST_WAKE.
config BCMDHD_SDIO_IRQ
	depends on BCMDHD_1_141_66 && BCMDHD_SDIO
	bool "In-Band Interrupt"
	---help---
	  Interrupt from SDIO DAT[1]
endchoice
```
